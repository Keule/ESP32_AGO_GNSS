## ag-steer/sdkconfig.defaults
```kconfig
# sdkconfig.defaults for LilyGO T-ETH-Lite-S3
# ESP32-S3-WROOM-1: 16 MB Flash, PSRAM disabled
#
# These settings are merged into the sdkconfig at build time.
# PlatformIO picks up this file automatically.

# === PSRAM: DISABLED ===
CONFIG_SPIRAM=n

# === Flash & App Settings ===
CONFIG_ESPTOOLPY_FLASHMODE_QIO=y
CONFIG_ESPTOOLPY_FLASHFREQ_80M=y
CONFIG_ESPTOOLPY_FLASHSIZE_16MB=y

# === Core Dump to Flash (stack trace on crash) ===
CONFIG_ESP_COREDUMP_ENABLE_TO_FLASH=y
CONFIG_ESP_COREDUMP_TO_FLASH=y

# === FreeRTOS ===
CONFIG_FREERTOS_HZ=1000

# === Logging ===
CONFIG_LOG_DEFAULT_LEVEL_INFO=y
CONFIG_LOG_MAXIMUM_LEVEL_DEBUG=y
```
